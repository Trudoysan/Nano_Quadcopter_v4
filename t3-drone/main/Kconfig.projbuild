## t3-drone/main/Kconfig.projbuild
```kconfig
menu "Nano Quadcopter Config"

    menu "led config"

        config LED_PIN_RED
            int "LED_PIN_RED GPIO number"
            range 0 43 
            default 5 
            help
                GPIO number (IOxx) LED_PIN_RED

    endmenu
    
        menu "calibration angle"
        config PITCH_CALIB
            int "PITCH_CALIB deg*100"
            range -200 200
            default 0
            help
                if PITCH error angle is 0.90,set this 90

        config ROLL_CALIB
            int "ROLL_CALIB deg*100"
            range -200 200
            default 0
            help
                if ROLL error angle is 0.90,set this 90
    endmenu
    
   menu "sensors config"
        config I2C0_PIN_SDA
            int "I2C0_PIN_SDA GPIO number"
            range 0 43
            default 21 
            help
                GPIO number (IOxx) I2C0_PIN_SDA

        config I2C0_PIN_SCL
            int "I2C0_PIN_SCL GPIO number"
            range 0 43 
            default 22 
            help
                GPIO number (IOxx) I2C0_PIN_SCL


        config SPI_PIN_MISO
            int "SPI_PIN_MISO GPIO number"
            range 0 43
            default 23 
            help
                GPIO number (IOxx) SPI_PIN_MISO

        config SPI_PIN_MOSI
            int "SPI_PIN_MOSI GPIO number"
            range 0 43 
            default 13 
            help
                GPIO number (IOxx) SPI_PIN_MOSI

        config SPI_PIN_CLK
            int "SPI_PIN_CLK GPIO number"
            range 0 43 
            default 14 
            help
                GPIO number (IOxx) SPI_PIN_CLK

        config SPI_PIN_CS0
            int "SPI_PIN_CS0 GPIO number"
            range 0 43 
            default 15 
            help
                GPIO number (IOxx) SPI_PIN_CS0

        config MPU_PIN_INT
            int "MPU_PIN_INT GPIO number"
            range 0 43 
            default 27 
            help
                GPIO number (IOxx) MPU_PIN_INT

        config ADC1_PIN
            int "ADC1_PIN GPIO number"
            range 1 10 
            default 2 
            help
                GPIO number (IOxx) ADC1_PIN


    endmenu
    
 menu "motors config"
         config MOTOR01_PIN
            int "MOTOR01_PIN GPIO number"
            range 0 43 
            default 25 
            help
                GPIO number (IOxx) MOTOR01_PIN

        config MOTOR02_PIN
            int "MOTOR02_PIN GPIO number"
            range 0 43 
            default 26 
            help
                GPIO number (IOxx) MOTOR02_PIN

        config MOTOR03_PIN
            int "MOTOR03_PIN GPIO number"
            range 0 43 
            default 18 
            help
                GPIO number (IOxx) MOTOR03_PIN

        config MOTOR04_PIN
            int "MOTOR04_PIN GPIO number"
            range 0 43 
            default 19 
            help
                GPIO number (IOxx) MOTOR04_PIN
    endmenu


endmenu
```
